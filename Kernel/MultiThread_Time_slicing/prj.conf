## CMakeLists.txt
```
# SPDX-License-Identifier: Apache-2.0

cmake_minimum_required(VERSION 3.20.0)
find_package(Zephyr REQUIRED HINTS $ENV{ZEPHYR_BASE})
project(MultiThread_Time_slicing)

target_sources(app PRIVATE src/main.c)
```

## prj.conf
```kconfig
# enables the time slicing feature
CONFIG_TIMESLICING=y

# the maximum time (in ms) that the current running thread has before it is forcefully 
# preempted by the scheduler to allow the other equal priority threads to run.
CONFIG_TIMESLICE_SIZE=10

# the priority threshold for time slicing, meaning threads with higher priority
# than this threshold are not subject to time slicing. unless two or more threads
# exist in one level of pririty
CONFIG_TIMESLICE_PRIORITY=0
```

## src/main.c
```c
/*
 * Copyright (c) 2017 Linaro Limited
 *
 * SPDX-License-Identifier: Apache-2.0
 */

#include <zephyr/kernel.h>
#include <zephyr/sys/printk.h>

/* Define stack size and scheduling priority used by each thread */
#define STACKSIZE 1024
#define THREAD0_PRIORITY 7
#define THREAD1_PRIORITY 7

		
void thread0(void)
{
	while (1) {
		/* Call printk() to display a simple string "Hello, I am thread0" */
		printk("Hello, I am thread0\n");
		/* to prevent the serial terminal from being flooded by logs */
		k_busy_wait(100000);

	}
}

void thread1(void)
{
	while (1) {
		/* Call printk() to display a simple string "Hello, I am thread1" */
		printk("Hello, I am thread1\n");
		/* to prevent the serial terminal from being flooded by logs */
		k_busy_wait(100000);

	}
}


/* Define and initialize the two threads */
K_THREAD_DEFINE(thread0_id, STACKSIZE, thread0, NULL, NULL, NULL,
		THREAD0_PRIORITY, 0, 0);
K_THREAD_DEFINE(thread1_id, STACKSIZE, thread1, NULL, NULL, NULL,
		THREAD1_PRIORITY, 0, 0);
```
